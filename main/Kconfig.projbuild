## main/Kconfig.projbuild
```kconfig
menu "GSM PPPoS configuration"

    choice MODEM_DEVICE
        prompt "Choose supported modem device (DCE)"
        default MODEM_DEVICE_BG96
        help
            Select modem device connected to the ESP DTE.
        config MODEM_DEVICE_SIM800
            bool "SIM800"
            help
                SIMCom SIM800L is a GSM/GPRS module.
                It supports Quad-band 850/900/1800/1900MHz.
        config MODEM_DEVICE_BG96
            bool "BG96"
            help
                Quectel BG96 is a series of LTE Cat M1/Cat NB1/EGPRS module.
    endchoice

    config GSM_DEBUG
        bool "Enable GSM debugging"
        default y
        help
            Show GSM debug messages

    config GSM_TX
        int "UART Output to GSM Module"
        default 25
        range 1 30
        help
        UART Tx pin, connected to GSM Module Rx pin.

    config GSM_RX
        int "UART Input from GSM Module"
        default 26
        range 1 38
        help
        UART Rx pin, connected to GSM Module Tx pin.
        
    config GSM_POWER
        int "Power Pin GSM Module"
        default 23
        range 1 38
        help
        GSM Module Power pin 

    config GSM_PWKEY
        int "PWKEY Pin GSM Module"
        default 4
        range 1 38
        help
        GSM Module Power pin  

    config GSM_RST
        int "RST Pin GSM Module"
        default 5
        range 1 38
        help
        GSM Module reset pin 

    config GSM_BDRATE
        int "UART Baud rate"
        default 115200
        help
        UART baudrate to comunicate with GSM module

    config GSM_INTERNET_USER
        string "Internet User"
        default ""
        help
            Network provider internet user.

    config GSM_INTERNET_PASSWORD
        string "Internet password"
        default ""
        help
            Network provider internet password
            
    config GSM_APN
        string "Internet APN"
        default "providerAPN"
        help
        Network provider's APN for internet access

    config GSM_USE_WIFI_AP
        bool "Start WiFi and AP"
        default n
        help
            Start WiFi as Acces Point and create WebServer task

    config GSM_SEND_SMS
        bool "Send SMS message"
        default n
        help
            Send SMS messages during example run

    config GSM_SMS_NUMBER
        string "SMS number"
        depends on GSM_SEND_SMS
        default "+123456789"
        help
        SMS number for sending messages
        Enter the number in international format (+1234567899)

    config GSM_SMS_INTERVAL
        int "SMS message interval"
        depends on GSM_SEND_SMS
        default 300000
        range 180000 3600000
        help
        Set SMS message interval in mili seconds

endmenu
```
